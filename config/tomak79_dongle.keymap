#include "tomak79.keymap"

/ {
    sensors {
        compatible = "zmk,keymap-sensors";
        sensors = <&encoder_dongle>;
        triggers-per-rotation = <20>;
    };
};

&{/keymap/default_layer} {
    sensor-bindings = <&inc_dec_kp C_VOL_UP C_VOL_DN>;
};
