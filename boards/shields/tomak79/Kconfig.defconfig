## boards/shields/tomak79/Kconfig.defconfig
```kconfig
if SHIELD_TOMAK79_LEFT || SHIELD_TOMAK79_RIGHT || SHIELD_TOMAK79_DONGLE

config ZMK_KEYBOARD_NAME
    default "Tomak79"

config ZMK_SPLIT
    default y

endif
```

## boards/shields/tomak79/Kconfig.shield
```kconfig
config SHIELD_TOMAK79_LEFT
    def_bool $(shields_list_contains,tomak79_left)

config SHIELD_TOMAK79_RIGHT
    def_bool $(shields_list_contains,tomak79_right)

config SHIELD_TOMAK79_DONGLE
    def_bool $(shields_list_contains,tomak79_dongle)

config SHIELD_TOMAK79_DONGLE_I2C_TEST
    def_bool $(shields_list_contains,tomak79_dongle_i2c_test)
```
